## components/board_ws128/Kconfig
```kconfig
menu "Board: Waveshare ESP32-S3-Touch-LCD-1.28"

    config BOARD_LCD_PCLK_MHZ
        int "LCD SPI clock (MHz)"
        default 80
        range 10 80
        help
            The GC9A01 has no tearing-effect line on this board, so nothing syncs a frame
            write to the panel's own refresh (~60 Hz). A full 240x240 RGB565 frame is
            921,600 bits: 23 ms at 40 MHz -- longer than one refresh, so a new frame is seen
            sweeping down the screen -- and 11.5 ms at 80 MHz, inside one. Drop to 40 if the
            picture shows corruption at 80.

    config BOARD_LCD_CYCLE_AT_BOOT
        bool "Start the red/green/blue/white LCD test cycle at boot"
        default y

    config BOARD_TOUCH_ENABLE
        bool "Build the CST816S touch driver"
        default y
        help
            Compiles in the touch driver and the `touch on|off|status` command. Even
            when built, touch is off until `touch on` unless BOARD_TOUCH_AUTOSTART is set.

    config BOARD_TOUCH_AUTOSTART
        bool "Start touch reporting at boot"
        depends on BOARD_TOUCH_ENABLE
        default n

endmenu
```

## components/hostlink/Kconfig
```kconfig
menu "Host link (hostlink)"

    choice HOSTLINK_MODE
        prompt "Transport, unless the saved link settings say otherwise"
        default HOSTLINK_MODE_OFF
        help
            The link on P2's spare pins, for a controller on a wire. `link mode` on the console,
            PATCH /api/v1/link, or the web app's Settings page change it, saved.

        config HOSTLINK_MODE_OFF
            bool "Off"
        config HOSTLINK_MODE_UART
            bool "UART"
        config HOSTLINK_MODE_RS485
            bool "RS485 (a transceiver, DE/RE on pin C)"
    endchoice

    choice HOSTLINK_PROTOCOL
        prompt "What UART and RS485 accept"
        default HOSTLINK_PROTOCOL_AUTO
        config HOSTLINK_PROTOCOL_AUTO
            bool "Either: JSON lines or native frames, by the first byte"
        config HOSTLINK_PROTOCOL_JSON
            bool "JSON lines"
        config HOSTLINK_PROTOCOL_NATIVE
            bool "Native frames"
    endchoice

    config HOSTLINK_PIN_A
        int "Pin A: TX, or SDA"
        default 21
        help
            P2 pin 11.

    config HOSTLINK_PIN_B
        int "Pin B: RX, or SCL"
        default 33
        help
            P2 pin 12.

    config HOSTLINK_PIN_C
        int "Pin C: ATTN, DE/RE, or IRQ (-1 for none)"
        default 15
        range -1 48
        help
            P2 pin 7.

    config HOSTLINK_BAUD
        int "Baud rate"
        default 115200
        range 1200 921600

    config HOSTLINK_ADDRESS
        int "The board's address on UART and RS485"
        default 1
        range 1 223

    config HOSTLINK_I2C_ADDRESS
        hex "The board's I2C address"
        default 0x42
        range 0x08 0x77

    config HOSTLINK_TASK_STACK
        int "The link task's stack"
        default 10240
        help
            A request runs on it, as on the web server's: showing an image decodes it there.

endmenu
```

## components/jpegdec/Kconfig
```kconfig
menu "JPEGDEC (bitbank2)"

    choice JPEGDEC_VERSION
        prompt "Version"
        default JPEGDEC_V1_5_0
        help
            Both are vendored under components/jpegdec; only one can be linked.

        config JPEGDEC_V1_5_0
            bool "1.5.0 (what the Flash_PNG sketch used)"
        config JPEGDEC_V1_8_4
            bool "1.8.4 (latest, November 2025)"
    endchoice

    config JPEGDEC_S3_SIMD
        bool "Use the ESP32-S3 SIMD colour conversion and dequantisation"
        default y
        depends on IDF_TARGET_ESP32S3
        help
            JPEGDEC's hand-written ESP32-S3 assembly, which its Arduino builds use.

endmenu
```

## components/leds/Kconfig
```kconfig
menu "LED strip (NeoPixel)"

    config LEDS_GPIO
        int "Data GPIO"
        default 16
        range 0 48
        help
            The strip's data line. 16 is P2 pin 8 on the Waveshare ESP32-S3-Touch-LCD-1.28,
            the pin the Flash_PNG sketch drove its NeoPixels from (PIN_NEO_PIXEL).

    config LEDS_COUNT
        int "LEDs on the strip"
        default 16
        range 1 1024
        help
            Flash_PNG's NUM_PIXELS.

    choice LEDS_SPEED
        prompt "Data rate"
        default LEDS_SPEED_400K
        help
            Flash_PNG drove its strip at 400 kHz (NEO_KHZ400). That is the native rate of
            WS2811 driver chips and first-generation NeoPixels; WS2812/WS2812B/SK6812
            NeoPixels are 800 kHz parts, though most accept the 400 kHz timing too.

        config LEDS_SPEED_400K
            bool "400 kHz (WS2811; Flash_PNG's NEO_KHZ400)"
        config LEDS_SPEED_800K
            bool "800 kHz (WS2812, WS2812B, SK6812)"
    endchoice

    choice LEDS_ORDER
        prompt "Colour order on the wire"
        default LEDS_ORDER_GRB
        help
            Flash_PNG's NEO_GRB, and that of nearly every WS2812-family part. If red and
            green come out swapped, the strip is RGB.

        config LEDS_ORDER_GRB
            bool "GRB"
        config LEDS_ORDER_RGB
            bool "RGB"
    endchoice

    config LEDS_BRIGHTNESS
        int "Brightness at boot (percent)"
        default 100
        range 1 100
        help
            `leds bright` changes it live. Each LED draws up to about 60 mA at full white,
            so a 16-LED strip at 100% can want 1 A: more than the P2 header's VSYS pin and
            its SH1.0 contact should be asked for. Powering the strip from the header, keep
            this at 30 or below; powered from its own 5 V supply, leave it at 100.

endmenu
```

## components/webui/Kconfig
```kconfig
menu "Web app (webui)"

    config WEBUI_RELEASES_URL
        string "Where release channels are published"
        default "https://davidiansmith.ca/holo-player-fw/"
        help
            The documentation site, which carries each release's firmware. A channel such as
            `latest` is looked up in <this>versions.json, and its image described by
            <this><version>/firmware/manifest.json. The site's own domain, not
            daveismith.github.io: that redirects through plain http, which a pull refuses.

    config WEBUI_EVENTS_SYNC_S
        int "While a clip plays or a scene runs, send its state this often (seconds)"
        default 5
        range 1 60
        help
            The `screen` event (with the clip's frame and loop counts) and the `scene` event (with
            its time left) are sent when they change, and this often besides while a clip plays
            or a scene runs to its end, so a client that counts on by itself between events is
            put right again, however its clock or the clip's real frame rate drifts.

endmenu
```

## main/Kconfig.projbuild
```kconfig
menu "holo-player-fw"

    config CONSOLE_STORE_HISTORY
        bool "Store command history in flash"
        default y
        help
            Save the console's command history to /data/history.txt on the LittleFS
            `storage` volume, so it survives a restart.

    config CONSOLE_IGNORE_EMPTY_LINES
        bool "Ignore empty lines inserted into the console"
        default y
        help
            If an empty line is inserted to the console, the Console can either
            ignore empty lines (the example would continue), or break on empty lines
            (the example would stop after an empty line).

endmenu

menu "Holoprojector servos"

    config HOLO_SERVO1_GPIO
        int "Servo 1 GPIO"
        default 17
        range 0 48
        help
            P2 pin 9 on the Waveshare ESP32-S3-Touch-LCD-1.28.

    config HOLO_SERVO1_MIN_US
        int "Servo 1 travel: minimum pulse (us)"
        default 1150
        range 500 2500
        help
            Servo 1's working range runs from this to its maximum until `holo endpoints`
            saves one. The minimum is CLOSED: full left for the pan axis, full down for tilt.
            If the axis runs the wrong way, save endpoints with closed above open.

    config HOLO_SERVO1_MAX_US
        int "Servo 1 travel: maximum pulse (us)"
        default 1900
        range 500 2500

    config HOLO_SERVO2_GPIO
        int "Servo 2 GPIO"
        default 18
        range 0 48
        help
            P2 pin 10 on the Waveshare ESP32-S3-Touch-LCD-1.28.

    config HOLO_SERVO2_MIN_US
        int "Servo 2 travel: minimum pulse (us)"
        default 1300
        range 500 2500

    config HOLO_SERVO2_MAX_US
        int "Servo 2 travel: maximum pulse (us)"
        default 1950
        range 500 2500

    choice HOLO_PAN
        prompt "Which servo pans (left and right)"
        default HOLO_PAN_SERVO1
        help
            The other one tilts. If `holo wag` nods rather than shaking its head, choose
            the other.

        config HOLO_PAN_SERVO1
            bool "Servo 1"
        config HOLO_PAN_SERVO2
            bool "Servo 2"
    endchoice

    config HOLO_SERVO_ABS_MIN_US
        int "Absolute minimum pulse (us)"
        default 1000
        range 500 2500
        help
            Neither servo is ever sent a shorter pulse, whatever `servo_move` or a saved
            calibration asks for. Each servo's travel must lie inside the absolute range.

    config HOLO_SERVO_ABS_MAX_US
        int "Absolute maximum pulse (us)"
        default 2000
        range 500 2500

endmenu

menu "Wi-Fi fallback"

    config HOLO_WIFI_FALLBACK_AP
        bool "Start the access point when the board can't join a network at start"
        default y
        help
            With no saved network, or none joined within HOLO_WIFI_JOIN_WAIT_S of starting,
            the board turns its own access point on for HOLO_WIFI_FALLBACK_AP_MIN minutes, so
            a phone can reach it to set one up.

    config HOLO_WIFI_FALLBACK_AP_MIN
        int "Minutes the access point stays on, at start or from the button"
        default 5
        range 1 120

    config HOLO_WIFI_JOIN_WAIT_S
        int "Seconds to wait for a network before the access point"
        default 20
        range 5 120
        help
            How long a join (the rejoin at start, or one the button starts) has before the
            board gives up on it and turns the access point on. The station keeps trying in
            the background.

    config HOLO_WIFI_BUTTON_GPIO
        int "Wi-Fi button GPIO (-1: none)"
        default 0
        range -1 48
        help
            A button to ground. Pressed while the board is not on a network, it rejoins the
            saved network and, if that doesn't work, turns the access point on for
            HOLO_WIFI_FALLBACK_AP_MIN minutes. GPIO0 is the BOOT button on the Waveshare
            ESP32-S3-Touch-LCD-1.28 (also P2 pin 4).

endmenu
```
