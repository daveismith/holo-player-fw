## components/board_ws128/Kconfig
```kconfig
menu "Board: Waveshare ESP32-S3-Touch-LCD-1.28"

    config BOARD_LCD_PCLK_MHZ
        int "LCD SPI clock (MHz)"
        default 80
        range 10 80
        help
            The GC9A01 has no tearing-effect line on this board, so nothing syncs a frame
            write to the panel's own refresh (~60 Hz). A full 240x240 RGB565 frame is
            921,600 bits: 23 ms at 40 MHz -- longer than one refresh, so a new frame is seen
            sweeping down the screen -- and 11.5 ms at 80 MHz, inside one. Drop to 40 if the
            picture shows corruption at 80.

    config BOARD_TOUCH_ENABLE
        bool "Build the CST816S touch driver"
        default y
        help
            Compiles in the touch driver and the `touch on|off|status` command. Even
            when built, touch reporting starts as the board's settings say (`settings touch`,
            the Cyphal register r2.touch.reporting): off unless set, or unless
            BOARD_TOUCH_AUTOSTART makes on the default.

    config BOARD_TOUCH_AUTOSTART
        bool "Start touch reporting at boot"
        depends on BOARD_TOUCH_ENABLE
        default n
        help
            The default of the touch reporting setting (settings_t.touch): on at every start
            until the setting is saved otherwise (`settings touch off`, PATCH /api/v1/settings,
            or the Cyphal register r2.touch.reporting).

endmenu
```

## components/canbus/Kconfig
```kconfig
menu "CAN (canbus)"

    config CANBUS_RX_QUEUE_LEN
        int "Frames the receive queue holds"
        default 256
        range 16 1024
        help
            Between the controller's interrupt and whoever reads the frames (the `can` command,
            or the Cyphal node). 24 bytes each, in internal RAM, from the first start on.

            A flash write holds the reader off while the interrupt goes on filling the queue:
            an erase runs for up to CONFIG_SPI_FLASH_ERASE_YIELD_DURATION_MS (20 ms) before it
            yields. Measured 2026-11-20 with a bus saturated at 1 Mbit/s by 8-byte frames
            (about 8,100 a second) during a 1 MB LittleFS write (`fs bench 1024`): the queue
            held 155 and 164 frames at most in two runs, and a 128-frame queue dropped 997 frames
            over the write. 256 covers that with room. A bus saturated with shorter frames (up to
            about 21,000 a second with no data) would need more; a Cyphal bus is normally far
            lighter.

    config CANBUS_TX_QUEUE_LEN
        int "Frames waiting to be sent"
        default 16
        range 2 255
        help
            Frames given to canbus_send() and not yet on the bus. When they are all waiting
            (nobody acknowledging, or bus-off), canbus_send() waits for room or times out.

endmenu
```

## components/cyphal/Kconfig
```kconfig
menu "Cyphal node (cyphal)"

    config CYPHAL_DEFAULT_NAME
        string "The node's name in uavcan.node.GetInfo, until `cyphal name` changes it"
        default "node"
        help
            1 to 50 characters of a-z, 0-9, _ and ., with no empty part and no part starting with
            a digit (manual/use/cyphal.md, "The name"). Checked at start: a default that breaks
            the rules is replaced by "node", with a warning. A firmware sets its own in its
            sdkconfig.defaults.

    config CYPHAL_NAME_REGISTER
        string "The register that holds the node's name"
        default "node.name"
        help
            The name uavcan.register.Access reads and writes the node's name by (the setting
            `cyphal name` changes): a register name by the standard's rules, a-z, 0-9, _ and .,
            with at least one dot. Not uavcan.node.description, which is a free-text note that
            doesn't change what GetInfo reports. A firmware sets its own in its
            sdkconfig.defaults.

    config CYPHAL_UNIQUE_ID_PREFIX
        string "The unique ID's first 8 bytes: the firmware's name"
        default "esp-node"
        help
            Exactly 8 characters. The unique ID is these 8 bytes, two zero bytes and the chip's
            base MAC address (manual/use/cyphal.md, "The unique ID"). An allocator gives a node-ID
            by unique ID, so changing this gives every board a new node-ID: a firmware pins its
            own in its sdkconfig.defaults.

    config CYPHAL_HARDWARE_VERSION_MAJOR
        int "The hardware version GetInfo reports: major"
        default 0
        range 0 255

    config CYPHAL_HARDWARE_VERSION_MINOR
        int "The hardware version GetInfo reports: minor"
        default 0
        range 0 255

    config CYPHAL_HEAP_SIZE
        int "libcanard's heap (bytes, in PSRAM)"
        default 32768
        range 8192 131072
        help
            A heap of its own for libcanard, reserved at the node's first start and kept, in PSRAM
            when there is any. Each start begins it empty. It holds the transmit queue (at most
            160 frames, 84 bytes each with the allocator's overhead: 13.4 KB; a port list is 22
            frames), the receive sessions (36 bytes for each node and service that has sent this
            board a request: 4.6 KB for 127 nodes on one service; and, while it waits for a
            node-ID, one for each allocator that answers) and each transfer as it is reassembled,
            at its type's extent (a register request, 515 bytes). Measured 2026-11-20 with the
            register and command services and the port list: 1,932 bytes at most (a port list
            waiting to go), through 500 GetInfo calls back to back and the whole hardware suite;
            2,016 alone on the bus for 10 minutes, where every transfer waits out its second.
            `cyphal` shows how much it has held at most.

    config CYPHAL_TASK_PRIORITY
        int "The node task's priority"
        default 5
        range 1 24
        help
            The task reads the controller's receive queue (CONFIG_CANBUS_RX_QUEUE_LEN frames) and
            keeps the heartbeat on time, so it should not wait behind a task that keeps a core
            busy, such as a video player.

    config CYPHAL_TASK_CORE
        int "The core the node task runs on"
        default 0
        range 0 1

    config CYPHAL_TASK_STACK
        int "The node task's stack (bytes)"
        default 3072
        help
            In internal RAM, while the node runs. Measured 2026-11-20 with `cyphal`'s report of the
            stack never used, over 500 GetInfo calls back to back, a clip, an update written over
            Wi-Fi, board restarts and every kind of collision stop (the listen, running, and in the
            middle of a response): 1,312 bytes used in most runs, 1,636 at most (924 never used),
            after a log line (going online, or the collision warning). With plug-and-play, the
            same day: 1,756 at most (804 never used), just after an allocation, whose log line is
            written from inside the transmit path; the same after a 15-minute soak with a clip, the
            LED ring and the web app. Log lines are the deepest calls; the spread is
            interrupts' register spills. The register and command services deserialize and
            serialize on it too (their structs are in PSRAM, not on it), hence 3,072: measured
            2026-11-20 over the whole hardware suite, 1,552 bytes used at most (1,520 never used),
            in the test of a collision in the middle of a response.

    config CYPHAL_WORKER_STACK
        int "The node's worker task's stack (bytes)"
        default 6144
        help
            In internal RAM, from the node's first start on. The worker does what the node's task
            may not wait for: a register written to NVS, a restart, a factory reset (NVS), and
            identify, which applies a scene (the screen and the LED ring, on this board). Measured
            2026-11-20: 2,844 bytes used at most (3,300 never used), after identify five times and
            refused register writes with their log lines. A later phase's routes (an image shown,
            which decodes it) will want more, as the host link's task has (10 KB).

    config CYPHAL_WORKER_PRIORITY
        int "The node's worker task's priority"
        default 5
        range 1 24
        help
            Below the node's task (CONFIG_CYPHAL_TASK_PRIORITY), which must never wait for it; the
            host link's task, which runs the same kind of work, is at 5.

endmenu
```
